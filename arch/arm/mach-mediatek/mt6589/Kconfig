## arch/arm/mach-mediatek/mt6589/Kconfig
```kconfig
if TARGET_MT6589

choice
	prompt "MT6589 board select"
	optional

config TARGET_LENOVO_BLADE
	bool "Lenovo YOGA Tablet 8/10 board"

endchoice

config SYS_SOC
	default "mt6589"

source "board/lenovo/blade/Kconfig"

endif
```

## board/lenovo/blade/Kconfig
```kconfig
if TARGET_LENOVO_BLADE

config SYS_BOARD
	default "blade"

config SYS_VENDOR
	default "lenovo"

endif
```

## board/lenovo/yoga-tablet-10/Kconfig
```kconfig
if TARGET_YOGA_TABLET_10

config SYS_BOARD
	default "yoga-tablet-10"

config SYS_VENDOR
	default "lenovo"

endif
```

## configs/mt6589_lenovo_blade_defconfig
```kconfig
CONFIG_ARM=y
CONFIG_ARCH_MEDIATEK=y
CONFIG_TARGET_MT6589=y
CONFIG_DEFAULT_DEVICE_TREE="mt6589-lenovo-b8000"
#CONFIG_DEFAULT_FDT_FILE="mt6589-lenovo-b8000"
CONFIG_OF_LIBFDT=y

# maybe nonsense
CONFIG_SYS_LOAD_ADDR=0x82000000

# Address when loaded from LittleKernel
CONFIG_TEXT_BASE=0x80008000
CONFIG_POSITION_INDEPENDENT=y

# for 2nd bootloader
CONFIG_LINUX_KERNEL_IMAGE_HEADER=y
CONFIG_SKIP_LOWLEVEL_INIT=y
CONFIG_SPL=n

### Commands
#CONFIG_CMD_FDT=y
## needed by logo
#CONFIG_CMD_BMP=y

### Logging
CONFIG_LOG=y
CONFIG_LOG_CONSOLE=y
CONFIG_LOGLEVEL=8

### Drivers

## Driver Model (DM) (they should move to appropriate section)
CONFIG_DM=y
CONFIG_DM_RESET=y
CONFIG_DM_MMC=y
CONFIG_DM_STDIO=y
CONFIG_DM_PMIC=y
CONFIG_DM_REGULATOR=y
CONFIG_DM_REGULATOR_FIXED=y
CONFIG_DM_KEYBOARD=y
CONFIG_DM_GPIO=y
CONFIG_NO_NET=y

## timer
CONFIG_TIMER=y
CONFIG_MTK_TIMER=y

## uart (not checked)
CONFIG_SERIAL=y
CONFIG_DM_SERIAL=y
CONFIG_MTK_SERIAL=y
#CONFIG_DEBUG_UART=y
#CONFIG_DEBUG_UART_SKIP_INIT=y

## Display (TODO: split)
CONFIG_VIDEO=y
CONFIG_VIDEO_SIMPLE=y
CONFIG_CONSOLE_NORMAL=y
CONFIG_VIDEO_LOGO=y
CONFIG_VIDEO_ANSI=y
CONFIG_CONSOLE_MUX=y

## watchdog
CONFIG_WATCHDOG=y
CONFIG_WATCHDOG_AUTOSTART=y
CONFIG_WDT=y
CONFIG_WDT_MTK=y

## USB (not working)
CONFIG_USB=y
CONFIG_PHY=y
CONFIG_PHY_MTK_TPHY=y
CONFIG_DM_USB_GADGET=y
CONFIG_USB_GADGET=y
CONFIG_USB_MUSB_GADGET=y
CONFIG_USB_MUSB_MT6572=y
# fake
CONFIG_USB_GADGET_MANUFACTURER="MediaTek-U-Boot"
CONFIG_USB_GADGET_VENDOR_NUM=0x0e8d
CONFIG_USB_GADGET_PRODUCT_NUM=0x2001

### Android fastboot
CONFIG_USB_GADGET_DOWNLOAD=y

## Clock (wip)
#CONFIG_CLK=y
```

## configs/yoga-tablet-10_defconfig
```kconfig
CONFIG_ARM=y
CONFIG_ARCH_MEDIATEK=y
CONFIG_TARGET_MT6589=y
CONFIG_TARGET_YOGA_TABLET_10=y
CONFIG_DEFAULT_DEVICE_TREE="mt6589-yoga-tablet-10"
#CONFIG_DEFAULT_FDT_FILE="mt6589-yoga-tablet-10.dtb"

CONFIG_LEAVE_MEDIATEK=y
#CONFIG_SYS_VENDOR="lenovo"
#CONFIG_SYS_BOARD="yoga-tablet-10"

# maybe nonsense
CONFIG_SYS_LOAD_ADDR=0x82000000

# Address when loaded from LittleKernel
CONFIG_TEXT_BASE=0x80008000

# for 2nd bootloader
CONFIG_LINUX_KERNEL_IMAGE_HEADER=y
#CONFIG_SKIP_LOWLEVEL_INIT=y
CONFIG_SPL=n
#CONFIG_BOARD_EARLY_INIT_F=n

# postmarketOS
#CONFIG_SYS_MALLOC_LEN

### Commands
#CONFIG_CMD_FDT=y
## needed by logo
#CONFIG_CMD_BMP=y

### Logging
CONFIG_LOG=y
CONFIG_LOG_CONSOLE=y
CONFIG_LOGLEVEL=8
CONFIG_PRE_CONSOLE_BUFFER=y
CONFIG_PRE_CON_BUF_ADDR=0x85000000

### etc
CONFIG_POSITION_INDEPENDENT=y
CONFIG_SYS_CONSOLE_IS_IN_ENV=y

### Drivers

## Driver Model (DM) (they should move to appropriate section)
CONFIG_DM=y
CONFIG_DM_RESET=y
CONFIG_DM_MMC=y
CONFIG_DM_STDIO=y
CONFIG_DM_PMIC=y
CONFIG_DM_REGULATOR=y
CONFIG_DM_REGULATOR_FIXED=y
CONFIG_DM_KEYBOARD=y
CONFIG_DM_GPIO=y

## timer
CONFIG_TIMER=y
CONFIG_MTK_TIMER=y

## uart (not checked)
CONFIG_SERIAL=y
CONFIG_DM_SERIAL=y
CONFIG_MTK_SERIAL=y
#CONFIG_DEBUG_UART=y
#CONFIG_DEBUG_UART_SKIP_INIT=y

## Display (TODO: split)
CONFIG_VIDEO=y
CONFIG_VIDEO_SIMPLE=y
CONFIG_BPP_16=y
CONFIG_VIDEO_DT_SIMPLEFB=y
#CONFIG_SPLASH_SCREEN=y
CONFIG_SYS_WHITE_ON_BLACK=y
CONFIG_CONSOLE_NORMAL=y
#CONFIG_DISPLAY=y
#CONFIG_FDT_SIMPLEFB=y
#CONFIG_VIDEO_LOGO=y
CONFIG_VIDEO_ANSI=y
#CONFIG_CONSOLE_SCROLL_LINES=0
CONFIG_CONSOLE_MUX=y

## watchdog
CONFIG_WATCHDOG=y
CONFIG_WATCHDOG_AUTOSTART=y
CONFIG_WDT=y
CONFIG_WDT_MTK=y

## USB (not working)
CONFIG_DM_USB=y
CONFIG_USB=y
CONFIG_PHY=y
CONFIG_PHY_MTK_TPHY=y
#CONFIG_USB_MUSB_HOST=y
CONFIG_DM_USB_GADGET=y
CONFIG_USB_GADGET=y
CONFIG_USB_MUSB_GADGET=y
CONFIG_USB_MUSB_MT6589=y
# fake
CONFIG_USB_GADGET_MANUFACTURER="MediaTek-U-Boot"
CONFIG_USB_GADGET_VENDOR_NUM=0x0e8d
CONFIG_USB_GADGET_PRODUCT_NUM=0x2001
# DMA Driver is not implemented
CONFIG_USB_MUSB_PIO_ONLY=y

### Android fastboot
#CONFIG_USB_GADGET_DOWNLOAD=y
#CONFIG_USB_GADGET_VENDOR_NUM=0x0bb4
#CONFIG_USB_GADGET_PRODUCT_NUM=0x0c01
#CONFIG_USB_GADGET_MANUFACTURER"Lenovo"

## Clock (wip)
CONFIG_CLK=y

## DMA
#CONFIG_DMA=y

### Disabling unused stuff
CONFIG_NET=n
CONFIG_NO_NET=y
CONFIG_CMD_NET=n
CONFIG_EFI_LOADER=n
CONFIG_CMD_ACPI=n
CONFIG_PXE_UTILS=n
```
