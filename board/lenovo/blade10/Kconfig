## board/lenovo/blade10/Kconfig
```kconfig
if TARGET_BLADE10

config SYS_BOARD
	default "blade10"

config SYS_VENDOR
	default "lenovo"

config SYS_CONFIG_NAME
	default "blade10"

endif
```

## configs/blade10_defconfig
```kconfig
CONFIG_ARM=y
CONFIG_ARCH_MEDIATEK=y
CONFIG_TARGET_MT6589=y
CONFIG_TARGET_BLADE10=y
CONFIG_DEFAULT_DEVICE_TREE="mt6589-blade10"

# mediatek/custom/mt6589/uboot/config.mk
CONFIG_TEXT_BASE=0x81E00000

CONFIG_SYS_LOAD_ADDR=0x84000000
# CONFIG_SYS_LOAD_ADDR=0x00000000 ?

# testing (from MT7623)
CONFIG_HAS_CUSTOM_SYS_INIT_SP_ADDR=y
CONFIG_CUSTOM_SYS_INIT_SP_ADDR=0x81ffff10

# MT7623
CONFIG_SYSRESET=y

# mediatek/custom/lenovo89_tb_x10_jb2/uboot/inc/configs/ubconfigs.h
# mediatek/custom/wiko/uboot/inc/configs/ubconfigs.h
# (same file)

#
# CONFIGURATION
#
# mt6575 fpga does not have L2 cache yet
CONFIG_L2_OFF=y
# no support for nor flash
CONFIG_MTD_NOR_FLASH=y

#
# UART/SERIAL
#
CONFIG_SERIAL1=y
CONFIG_CONS_INDEX=1
CONFIG_BAUDRATE=921600
CONFIG_SYSCLK=13500000

#
# DRAM
#
CONFIG_NR_DRAM_BANKS=1

#CONFIG_SYS_MEMTEST_START=(SDRAM_BASE+SZ_8M)
#CONFIG_SYS_MEMTEST_END=(SDRAM_BASE+SZ_16M)

#
# NAND FLASH
#
#ifdef CFG_NAND_BOOT
# max. number of NAND devices
CONFIG_SYS_MAX_NAND_DEVICE=1
CONFIG_SYS_NAND_CS=1
CONFIG_SYS_NAND_ADDR=0x80032000
CONFIG_SYS_NAND_BASE=CONFIG_SYS_NAND_ADDR
CONFIG_SYS_NAND_SELECT_DEVICE=y
#endif

#
# JFFS2 PARTITIONS
#
# will increase a lot of size
#undef CONFIG_JFFS2_CMDLINE

#ifdef CFG_NAND_BOOT
#CONFIG_JFFS2_CMDLINE=y
#CONFIG_JFFS2_NAND=y
#ifdef CONFIG_JFFS2_NAND
CONFIG_JFFS2_DEV="uboot"
CONFIG_JFFS2_PART_SIZE=0x00080000
CONFIG_JFFS2_PART_OFFSET=0x00000000
#endif
#endif

#
# MMC/SD CARD
#
#if defined(CFG_MMC_BOOT) || defined(CFG_MMC_FACTORY)
CONFIG_MMC=y
#endif

CONFIG_DOS_PARTITION=y

#
# U-BOOT ENVIRONMENT
#
CONFIG_MISC_INIT_R=y

# allow to overwrite serial and ethaddr
CONFIG_ENV_OVERWRITE=y

#CONFIG_SYS_LOAD_ADDR=0x00000000

# Size of malloc() pool
CONFIG_ENV_SIZE=0x00020000
#(CONFIG_ENV_SIZE + SZ_512K)
CONFIG_SYS_MALLOC_LEN=0xA0000
CONFIG_SYS_GBL_DATA_SIZE=128

#
# Miscellaneous configurable options
#
CONFIG_SYS_LONGHELP=y
CONFIG_SYS_PROMPT="u-boot> "
# Console I/O Buffer Size
CONFIG_SYS_CBSIZE=256

# Print Buffer Size
#(CONFIG_SYS_CBSIZE + sizeof("u-boot> ") + 16)
CONFIG_SYS_PBSIZE=280
# max number of command args
CONFIG_SYS_MAXARGS=16
# Boot Argument Buffer Size: CONFIG_SYS_CBSIZE
CONFIG_SYS_BARGSIZE=256

# CONFIG_TEXT_BASE
CONFIG_SYS_MONITOR_BASE=0x81E00000
# Reserve 1 sector: 0x00020000
CONFIG_SYS_MONITOR_LEN=131072

#ifdef CFG_NAND_BOOT
#(CONFIG_SYS_MONITOR_BASE + CONFIG_SYS_MONITOR_LEN)
CONFIG_ENV_ADDR=0x81E20000
# Environment after Monitor
#(CONFIG_ENV_ADDR + CONFIG_SYS_MONITOR_LEN)
CONFIG_ENV_OFFSET=0x81E40000
CONFIG_ENV_IS_NOWHERE=y
#else
# WTF!?
#CONFIG_ENV_ADDR=(CONFIG_ENV_ADDR + CONFIG_SYS_MONITOR_LEN)
# Environment after Monitor
#CONFIG_ENV_OFFSET=(CONFIG_ENV_ADDR + CONFIG_SYS_MONITOR_LEN)
CONFIG_ENV_IS_NOWHERE=y
#endif

#
# U-BOOT AUTOBOOT
#
# autoboot after in secs
CONFIG_BOOTDELAY=5
# autoboot command
CONFIG_BOOTCOMMAND="msdc_boot;nand_boot"

#
# U-BOOT COMMANDS
#
# Basic Command
#ifdef CFG_NAND_BOOT
# Hong-Rong: Open to develope nand driver
CONFIG_CMD_NAND=y
#endif

######################################################################

CONFIG_SYS_HZ=1000

#
# LINUX KERNEL BOOTARGS
#
# enable passing of ATAGs
CONFIG_CMDLINE_TAG=y
CONFIG_SETUP_MEMORY_TAGS=y
CONFIG_INITRD_TAG=y
CONFIG_REVISION_TAG=y

## if lcm is NOT inited, don't pass video LFB param to kernel
CONFIG_VIDEOLFB_TAG=y

# Jau Modify  64M -> 128M --> 122M

#ifdef CFG_NET_BOOT
CONFIG_BOOTARGS "mem=32M console=ttyMT0,921600n8 noinitrd root=/dev/nfs rw nfsroot=128.247.77.158:/home/a0384864/wtbu/rootfs ip=dhcp"
#else
# Hong-Rong: modify for MT6575 I
CONFIG_BOOTARGS="console=tty0 console=ttyMT0,921600n1 root=/dev/ram"
#endif

#
# USB
#
CONFIG_USBD_LANG="0409"
CONFIG_USBD_MANUFACTURER="MediaTek"
CONFIG_USBD_PRODUCT_NAME="MT6575"
#if 1 //MT6575 VCOM
CONFIG_USBD_VENDORID=0x0E8D
CONFIG_USBD_PRODUCTID=0x2000
#endif

#
# New Configurations in u-boot-2010.06
#
#-----------------------------------------------------------------------
# FLASH organization
#
# Max number of flash banks
CONFIG_SYS_MAX_FLASH_BANKS=1
# Max number of sectors per flash
CONFIG_SYS_MAX_FLASH_SECT=128

# Timeout for Flash Erase (in ms)
CONFIG_SYS_FLASH_ERASE_TOUT=120000
# Timeout for Flash Write (in ms)
CONFIG_SYS_FLASH_WRITE_TOUT=500
#
# Use the CFI flash driver for ease of use
#
#undef CONFIG_SYS_FLASH_CFI
#undef CONFIG_FLASH_CFI_DRIVER
CONFIG_ENV_IS_IN_FLASH=n

#
# MMU / Cache Operation
#
CONFIG_SYS_NO_DCACHE=y
```
